## boards/shields/noree/Kconfig.shield
```kconfig
# Copyright (c) 2024 Martin RESTA
# SPDX-License-Identifier: MIT

config SHIELD_NOREE_LEFT
    def_bool $(shields_list_contains,noree_left)

config SHIELD_NOREE_RIGHT
    def_bool $(shields_list_contains,noree_right)
```
